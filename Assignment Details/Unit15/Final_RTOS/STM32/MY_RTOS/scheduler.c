
#include "scheduler.h"

#include "My_RTOS_FIFO.h"



struct {
	Task_ref* OS_Tasks[100]; //Sch. Table
	unsigned int _S_MSP_Task ;
	unsigned int _E_MSP_Task ;
	unsigned int PSP_Task_Locator ;
	unsigned int No_Of_Active_Tasks ;
	Task_ref* Current_Task ;
	Task_ref* Next_Task ;
	enum{
		OS_Suspend,
		OS_Running
	}OS_Mode_ID;
}OS_Control;

typedef enum {
	SVC_Activate_Task,
	SVC_Terminate_Task,
	SVC_Task_Waiting_Time,
	SVC_Aquire_Mutex,
	SVC_Release_Mutex
}SVC_ID;

Queue_t Ready_QUEUE ;

Task_ref*  Ready_QUEUE_FIFO[100] ;
Task_ref  MY_RTOS_idle_Task ;

  //////////////////////////////////////////////////////////////////////////////////////////////
 //                                 Global Variable                                          //
//////////////////////////////////////////////////////////////////////////////////////////////

/**
 * @brief PendSV Handler - Performs the actual Context Switch between tasks.
 * Marked as 'naked' to prevent the compiler from adding prologue/epilogue code.
 */
__attribute__ ((naked)) void PendSV_Handler()
{
    /* =======================================================
     * 1. SAVE THE CONTEXT OF THE CURRENT TASK
     * ======================================================= */

    // Get the current Process Stack Pointer (PSP) into R0
    __asm volatile("mrs r0, psp");

    // Manually push registers R4 through R11 onto the task stack.
    // 'stmdb' (Store Multiple Decrement Before) updates R0 as it stores.
    __asm volatile("stmdb r0!, {r4-r11}");

    // Save the updated Stack Pointer (R0) back into OS_Control.Current_Task->Current_PSP
    // The 'offsetof' ensures the correct memory address is accessed regardless of padding.
    __asm volatile (
        "ldr r1, =OS_Control \n\t"
        "ldr r2, [r1, %0]    \n\t" // R2 = OS_Control.Current_Task pointer
        "str r0, [r2]        \n\t" // Store new PSP at the start of Task_ref struct
        :
        : "i" (offsetof(typeof(OS_Control), Current_Task))
    );

    /* =======================================================
     * 2. PERFORM THE CONTEXT SWITCH (LOGIC)
     * ======================================================= */

    // Update Current_Task pointer to the Next_Task chosen by the Scheduler
    if (OS_Control.Next_Task != NULL) {
        OS_Control.Current_Task = OS_Control.Next_Task;
        OS_Control.Next_Task = NULL;
    }

    /* =======================================================
     * 3. RESTORE THE CONTEXT OF THE NEXT TASK
     * ======================================================= */

    // Load the PSP of the new Current_Task into R0
    __asm volatile (
        "ldr r1, =OS_Control \n\t"
        "ldr r2, [r1, %0]    \n\t" // R2 = OS_Control.Current_Task
        "ldr r0, [r2]        \n\t" // R0 = Current_Task->Current_PSP
        "ldmia r0!, {r4-r11} \n\t" // Pop R4-R11 from the new stack

        // Update the CPU's PSP register with the new stack address
        "msr psp, r0         \n\t"

        // Exit Exception: Hardware automatically restores R0-R3, R12, LR, PC, xPSR
        "bx lr               \n\t"
        :
        : "i" (offsetof(typeof(OS_Control), Current_Task))
    );
}





unsigned char volatile  Idle_Task_Led;
void MY_RTOS_Idle_Task()
{

	//		The "wfi" (Wait For Interrupt) instruction is used to put the processor into a low-power state until an interrupt is received. An exception is a type of interrupt, but it is not the same as the interrupt that "wfi" is waiting for. Exceptions are typically caused by events such as illegal instruction execution, divide-by-zero, or memory access violation, and are typically handled by the processor's exception handler.
	//
	//		"wfi" instruction only waits for external interrupts which are generated by peripherals or external events and not the exceptional interrupts which are generated by the CPU itself.
	//
	//		In general, when you want to wait for any type of interrupt, you can use the "wfi" instruction, but if you want to wait for a specific event, you would use the "wfe" instruction, as it allows you to wait for a specific event, rather than any interrupt.
	//
	while(1)
	{

		Idle_Task_Led ^= 1 ;
		__asm("wfe");
	}


}


void MY_RTOS_Create_Main_Stack()
{
	OS_Control._S_MSP_Task = &_estack;
	OS_Control._E_MSP_Task = OS_Control._S_MSP_Task - Main_Stack_Size;
	//Aligned 8 Bytes spaces between Main Task and PSP tasks
	OS_Control.PSP_Task_Locator = (OS_Control._E_MSP_Task - 8);

	//if (_E_MSP_Task <&_eheap) Error:excedded the availble stack size
}




MY_RTOS_Error_ID MY_RTOS_Init()
{
	MY_RTOS_Error_ID error = NO_ERROR ;

	//Update OS Mode (OSsuspend)
	OS_Control.OS_Mode_ID = OS_Suspend ;

	//Specify the MAIN Stack for OS
	MY_RTOS_Create_Main_Stack();

	//Create OS Ready Queue
	if (Queue_Init(&Ready_QUEUE, Ready_QUEUE_FIFO, 100) !=QUEUE_OK)
	{
		error = Ready_Queue_Init_Error ;
	}

	//Configure IDLE TASK
	strcpy (MY_RTOS_idle_Task.Task_Name, "idleTask");
	MY_RTOS_idle_Task.priority = 255 ;
	MY_RTOS_idle_Task.P_Task_Entry = MY_RTOS_Idle_Task ;
	MY_RTOS_idle_Task.Stack_Size = 300 ;

	error = MY_RTOS_Create_Task(&MY_RTOS_idle_Task);

	return error ;

}

void My_RTOS_Create_Task_Stack(Task_ref* Tref)
{
	/*Task Frame
	 * ======
	 * XPSR
	 * PC (Next Task Instruction which should be Run)
	 * LR (return register which is saved in CPU while TASk1 running before TaskSwitching)
	 * r12
	 * r4
	 * r3
	 * r2
	 * r1
	 * r0
	 *====
	 *r5, r6 , r7 ,r8 ,r9, r10,r11 (Saved/Restore)Manual
	 */
	Tref->Current_PSP = Tref->_S_PSP_Task ;

	Tref->Current_PSP-- ;
	*(Tref->Current_PSP) = 0x01000000;         //DUMMY_XPSR should T =1 to avoid BUS fault;//0x01000000

	Tref->Current_PSP-- ;
	*(Tref->Current_PSP) = (unsigned int)Tref->P_Task_Entry ; //PC

	Tref->Current_PSP-- ; //LR = 0xFFFFFFFD (EXC_RETURN)Return to thread with PSP
	*(Tref->Current_PSP)  = 0xFFFFFFFD ;

	for (int  j=0 ; j< 13 ; j++ )
	{
		Tref->Current_PSP-- ;
		*(Tref->Current_PSP)  = 0 ;

	}

}


MY_RTOS_Error_ID MY_RTOS_Create_Task(Task_ref* Tref)
{
	MY_RTOS_Error_ID error = NO_ERROR ;

	//Create Its OWN PSP stack
	//Check task stack size exceeded the PSP stack
	Tref->_S_PSP_Task = OS_Control.PSP_Task_Locator;
	Tref->_E_PSP_Task = Tref->_S_PSP_Task - Tref->Stack_Size ;

	//	-				-
	//	- _S_PSP_Task	-
	//	-	Task Stack	-
	//	- _E_PSP_Task	-
	//	-				-
	//	- _eheap		-
	//	-				-
	//
	if(Tref->_E_PSP_Task < (unsigned int)(&(_eheap)))
	{
		return Task_Exceeded_Stack_Size ;
	}

	//Aligned 8 Bytes spaces between Task PSP and other
	OS_Control.PSP_Task_Locator = (Tref->_E_PSP_Task - 8);

	//Initialize PSP Task Stack
	My_RTOS_Create_Task_Stack( Tref);

	//update sch Table
	OS_Control.OS_Tasks[OS_Control.No_Of_Active_Tasks]= Tref ;
	OS_Control.No_Of_Active_Tasks++ ;


	//Task State Update -> Suspend
	Tref->Task_State = Suspend ;
	return error ;

}

//Handler
void bubbleSort()
{
	unsigned int i, j , n;
	Task_ref* temp ;
	n = OS_Control.No_Of_Active_Tasks ;
	for (i = 0; i < n - 1; i++)

		// Last i elements are already in place
		for (j = 0; j < n - i - 1; j++)
			if (OS_Control.OS_Tasks[j]->priority > OS_Control.OS_Tasks[j + 1]->priority)
			{
				temp = OS_Control.OS_Tasks[j] ;
				OS_Control.OS_Tasks[j] = OS_Control.OS_Tasks[j + 1 ] ;
				OS_Control.OS_Tasks[j + 1] = temp ;
			}

}
//Handler

void My_RTOS_Update_Schadule_Tables()
{
	Task_ref* temp =NULL ;
	Task_ref* P_task ;
	Task_ref* P_next_Task ;
	int i = 0 ;

	//1- bubble sort SchTable OS_Control-> OSTASKS[100] (priority high then low)
	bubbleSort();
	//2- free Ready Queue
	while(Queue_Dequeue(&Ready_QUEUE, &temp /* pointer to pointer */)!=QUEUE_EMPTY);

	//3- update ready queue

	while(i < OS_Control.No_Of_Active_Tasks)
	{
	    P_task = OS_Control.OS_Tasks[i];

	    if((i + 1) < OS_Control.No_Of_Active_Tasks)
	    {
	        P_next_Task = OS_Control.OS_Tasks[i+1];
	    }
	    else
	    {
	        P_next_Task = NULL;
	    }

	    if (P_task->Task_State != Suspend)
	    {
	        if (P_next_Task == NULL || P_next_Task->Task_State == Suspend)
	        {
	            Queue_Enqueue(&Ready_QUEUE, P_task);
	            P_task->Task_State = ready;
	            break;
	        }

	        if (P_task->priority < P_next_Task->priority)
	        {
	            Queue_Enqueue(&Ready_QUEUE, P_task);
	            P_task->Task_State = ready;
	            break;
	        }
	        else if (P_task->priority == P_next_Task->priority)
	        {
	            Queue_Enqueue(&Ready_QUEUE, P_task);
	            P_task->Task_State = ready;
	        }
	    }

	    i++;
	}
}

//Handler Mode

void Decide_What_Next() {
    // Default to Idle Task
    Task_ref* p_Next = &MY_RTOS_idle_Task;
    unsigned char highest_priority = 255;

    // 1. Scan for the best priority currently in 'ready' state
    for (int i = 0; i < OS_Control.No_Of_Active_Tasks; i++) {
        if (OS_Control.OS_Tasks[i]->Task_State == ready) {
            if (OS_Control.OS_Tasks[i]->priority < highest_priority) {
                highest_priority = OS_Control.OS_Tasks[i]->priority;
            }
        }
    }

    // 2. Apply Round Robin for tasks sharing the SAME highest priority
    static int last_index = 0;
    for (int j = 1; j <= OS_Control.No_Of_Active_Tasks; j++) {
        int index = (last_index + j) % OS_Control.No_Of_Active_Tasks;

        if (OS_Control.OS_Tasks[index]->Task_State == ready && OS_Control.OS_Tasks[index]->priority == highest_priority) {
            p_Next = OS_Control.OS_Tasks[index];
            last_index = index; // Save position for next tick
            break;
        }
    }

    OS_Control.Next_Task = p_Next;
}



//Handler Mode
void OS_SVC(int* Stack_Frame)
{
	//r0,r1,r2,r3,r12,LR,return address (PC) and XPSR
	unsigned char SVC_number ;
	SVC_number = *((unsigned char*)(((unsigned char*)Stack_Frame[6])-2)) ;

	switch (SVC_number)
	{
	case SVC_Activate_Task:
	case SVC_Terminate_Task:
		//Update Sch Table, Ready Queue
		My_RTOS_Update_Schadule_Tables();
		//OS is in Running State
		if (OS_Control.OS_Mode_ID == OS_Running)
		{
			if (strcmp(OS_Control.Current_Task->Task_Name,"idleTask") != 0)
			{
				//Decide what Next
				Decide_What_Next();

				//trigger OS_pendSV (Switch Context/Restore)
				Trigger_OS_PendSV();
			}
		}

		break;
	case SVC_Task_Waiting_Time:
		My_RTOS_Update_Schadule_Tables();

		break;
	}


}

//Thread Mode
void MY_RTOS_OS_SVC_Set(SVC_ID ID)
{
	switch (ID)
	{
	case SVC_Activate_Task:
		__asm("svc #0x00");
		break;
	case SVC_Terminate_Task:
		__asm("svc #0x01");
		break;
	case SVC_Task_Waiting_Time:
		__asm("svc #0x02");
		break;
	case SVC_Aquire_Mutex:
		__asm("svc #0x03");  //Assignment Task
		break;
	case SVC_Release_Mutex:
		__asm("svc #0x04"); //Assignment Task
		break;
	}
}
void MY_RTOS_Activate_Task (Task_ref* Tref)
{
	Tref->Task_State = Waiting ;
	MY_RTOS_OS_SVC_Set(SVC_Activate_Task);
}
void MY_RTOS_Terminate_Task (Task_ref* Tref)
{
	Tref->Task_State = Suspend ;
	MY_RTOS_OS_SVC_Set(SVC_Terminate_Task);
}


/**
 * @brief Places the current task into a blocked state for a specified number of system ticks.
 * @param NoTICKS: Duration of the delay in OS ticks (e.g., milliseconds).
 * @param SelfTref: Pointer to the task structure that is requesting the wait.
 */
void MY_RTOS_Task_Wait(unsigned int NoTICKS, Task_ref* SelfTref)
{
    // 1. Enable the timer-based blocking mechanism for this task
    SelfTref->Timing_Waiting.Blocking = Enable;

    // 2. Set the countdown value (number of SysTick interrupts to wait)
    SelfTref->Timing_Waiting.Ticks_Count = NoTICKS;

    // 3. Update task state to 'Suspend' to prevent the scheduler from picking it
    // The task will remain suspended until the SysTick handler restores it to 'ready'
    SelfTref->Task_State = Suspend;

    // 4. Trigger the PendSV exception to perform an immediate context switch.
    // This allows the CPU to run another ready task instead of wasting time in the current one.
    Trigger_OS_PendSV();
}



/**
 * @brief Starts the RTOS Kernel and begins the scheduling process.
 * This function transitions the system from MSP to PSP and starts the first task.
 */
void MY_RTOS_START_OS()
{
    // 1. Set the OS operational mode to 'Running'
    OS_Control.OS_Mode_ID = OS_Running;

    // 2. Assign the Idle Task as the default starting task
    OS_Control.Current_Task = &MY_RTOS_idle_Task;

    // 3. Add the Idle Task to the ready queue to ensure the Scheduler always has a task to run
    MY_RTOS_Activate_Task(OS_Control.Current_Task);

    // 4. Load the CPU's Process Stack Pointer (PSP) with the Current Task's stack address
    OS_Set_PSP(OS_Control.Current_Task->Current_PSP);

    // 5. Switch the CPU's Main Stack Pointer (MSP) to the Process Stack Pointer (PSP)
    OS_Switch_SP_to_PSP;

    // 6. Initialize and start the SysTick Timer to generate periodic scheduling ticks (e.g., 1ms)
    Start_Ticker();

    // 7. Enable Global Interrupts to allow SysTick and PendSV exceptions to fire
    __enable_irq();

    // 8. Manually trigger the PendSV exception to perform the first context switch
    // This allows the PendSV_Handler to restore the initial context and jump to the task entry point
    Trigger_OS_PendSV();

    // 9. Safety Infinite Loop: The CPU should never return to this point
    while(1);
}



/**
 * @brief Updates the waiting time for all blocked tasks.
 * This function should be called periodically (e.g., inside SysTick_Handler).
 */
void MY_RTOS_Update_Tasks_Waiting_Time() {
    for (int i = 0; i < OS_Control.No_Of_Active_Tasks; i++) {

        // Check if the task is currently blocked by a timer (Wait state)
        if (OS_Control.OS_Tasks[i]->Timing_Waiting.Blocking == Enable) {

            // Decrement the remaining sleep ticks
            OS_Control.OS_Tasks[i]->Timing_Waiting.Ticks_Count--;

            // If the delay period has expired (reaches 0 or less for safety)
            if (OS_Control.OS_Tasks[i]->Timing_Waiting.Ticks_Count <= 0) {

                // Disable the blocking flag for this task
                OS_Control.OS_Tasks[i]->Timing_Waiting.Blocking = Disable;

                // Reset Task State to 'ready' so the Scheduler can include it in the next cycle
                OS_Control.OS_Tasks[i]->Task_State = ready;
            }
        }
    }
}


/**
 * @brief Acquires a Mutex for the calling task.
 * @param Mref: Pointer to the Mutex reference structure.
 * @param Tref: Pointer to the Task requesting the Mutex.
 * @return MY_RTOS_Error_ID: Error status of the operation.
 */
MY_RTOS_Error_ID MY_RTOS_Acquire_Mutex(Mutex_ref* Mref, Task_ref* Tref)
{
    // Check if the Mutex is currently not owned by any task
    if (Mref->Current_TUser == NULL)
    {
        // Mutex is free; grant ownership to the requesting task
        Mref->Current_TUser = Tref;
    }
    else
    {
        // Mutex is occupied; current task must wait even if it has high priority
        // Set the current task as the next user in the waiting slot
        Mref->Next_TUser = Tref;

        // Transition task state to 'Suspend' to block its execution
        Tref->Task_State = Suspend;

        // Trigger an SVC call (Service Call) to invoke the Scheduler immediately
        // This ensures the CPU switches to another ready task without waiting for SysTick
        MY_RTOS_OS_SVC_Set(SVC_Terminate_Task);
    }
    return NO_ERROR;
}

/**
 * @brief Releases a Mutex and hands it over to the next waiting task.
 * @param Mref: Pointer to the Mutex reference structure.
 */
void MY_RTOS_Release_Mutex(Mutex_ref* Mref)
{
    // Ensure the Mutex is currently held by a task before releasing
    if (Mref->Current_TUser != NULL)
    {
        /*
         * Note: If Priority Inheritance was implemented, restore the
         * Original_Priority here before clearing ownership.
         * Mref->Current_TUser->priority = Mref->Current_TUser->Original_Priority;
         */

        // Transfer ownership to the next task in line (can be NULL if no one is waiting)
        Mref->Current_TUser = Mref->Next_TUser;
        Mref->Next_TUser = NULL;

        // If there was a waiting task, wake it up
        if (Mref->Current_TUser != NULL)
        {
            // Set the new owner's state to 'ready' to be picked by the Scheduler
            Mref->Current_TUser->Task_State = ready;

            // Trigger an SVC call to perform an immediate context switch to the woken task
            MY_RTOS_OS_SVC_Set(SVC_Activate_Task);
        }
    }
}
